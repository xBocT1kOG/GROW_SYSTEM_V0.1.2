#pragma once
#include "driver/i2c_master.h"
#include <string.h>

// Минимальный шрифт 5x7 (ASCII от 32 до 127) для экономии памяти
static const uint8_t font5x7[96][5] = {
    {0x00,0x00,0x00,0x00,0x00}, {0x00,0x00,0x2f,0x00,0x00}, {0x00,0x07,0x00,0x07,0x00}, {0x14,0x7f,0x14,0x7f,0x14},
    {0x24,0x2a,0x7f,0x2a,0x12}, {0x23,0x13,0x08,0x64,0x62}, {0x36,0x49,0x55,0x22,0x50}, {0x00,0x05,0x03,0x00,0x00},
    {0x00,0x1c,0x22,0x41,0x00}, {0x00,0x41,0x22,0x1c,0x00}, {0x14,0x08,0x3e,0x08,0x14}, {0x08,0x08,0x3e,0x08,0x08},
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    {0x00,0x00,0x7f,0x00,0x00}, {0x00,0x41,0x36,0x08,0x00}, {0x10,0x08,0x08,0x10,0x08}, {0x00,0x00,0x00,0x00,0x00}
};

static void oled_cmd(i2c_master_dev_handle_t handle, uint8_t cmd) {
    uint8_t buf[2] = {0x00, cmd};
    i2c_master_transmit(handle, buf, 2, -1);
}

static void oled_init(i2c_master_dev_handle_t handle) {
    uint8_t init_cmds[] = { 0xAE, 0x20, 0x00, 0x21, 0x00, 0x7F, 0x22, 0x00, 0x07, 0x8D, 0x14, 0xAF };
    for (int i = 0; i < sizeof(init_cmds); i++) oled_cmd(handle, init_cmds[i]);
}

static void oled_clear(i2c_master_dev_handle_t handle) {
    uint8_t empty[129] = {0x40}; // 0x40 = data byte, rest are 0s
    for (uint8_t p = 0; p < 8; p++) {
        oled_cmd(handle, 0xB0 + p); oled_cmd(handle, 0x00); oled_cmd(handle, 0x10);
        i2c_master_transmit(handle, empty, 129, -1);
    }
}

static void oled_print(i2c_master_dev_handle_t handle, uint8_t col, uint8_t page, const char *str) {
    oled_cmd(handle, 0xB0 + page);
    oled_cmd(handle, 0x00 + (col & 0x0F));
    oled_cmd(handle, 0x10 + ((col >> 4) & 0x0F));
    
    uint8_t buf[129] = {0x40}; // 0x40 означает, что дальше идут данные
    int buf_idx = 1;
    
    while (*str && buf_idx < 120) {
        if (*str >= 32 && *str <= 127) {
            for (int i = 0; i < 5; i++) buf[buf_idx++] = font5x7[*str - 32][i];
            buf[buf_idx++] = 0x00; // Пробел между буквами
        }
        str++;
    }
    i2c_master_transmit(handle, buf, buf_idx, -1);
}