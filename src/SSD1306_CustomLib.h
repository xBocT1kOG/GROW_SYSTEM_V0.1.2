#include <stdio.h>
#include <string.h>
#include "driver/i2c_master.h" // I2C !!!Master!!! Library

extern i2c_master_bus_handle_t bus_handle;
extern i2c_master_dev_handle_t oled_handle;

// Base font(5x8 pixels per character, only supports ASCII 32-90 -> upper case, digits, and some symbols)
static const uint8_t font5x8[59][5] = {
    {0x00,0x00,0x00,0x00,0x00}, {0x00,0x00,0x5F,0x00,0x00}, {0x00,0x07,0x00,0x07,0x00}, {0x14,0x7F,0x14,0x7F,0x14},
    {0x24,0x2A,0x7F,0x2A,0x12}, {0x23,0x13,0x08,0x64,0x62}, {0x36,0x49,0x55,0x22,0x50}, {0x00,0x05,0x03,0x00,0x00},
    {0x00,0x1C,0x22,0x41,0x00}, {0x00,0x41,0x22,0x1C,0x00}, {0x08,0x2A,0x1C,0x2A,0x08}, {0x08,0x08,0x3E,0x08,0x08},
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    {0x63,0x14,0x08,0x14,0x63}, {0x03,0x04,0x78,0x04,0x03}, {0x61,0x51,0x49,0x45,0x43}
};

// Base functions for OLED control
static void oled_cmd(uint8_t cmd) {
    uint8_t buf[2] = {0x00, cmd};
    i2c_master_transmit(oled_handle, buf, 2, -1);
}

static void oled_data(const uint8_t *data, size_t len) {
    uint8_t buf[129];
    buf[0] = 0x40;
    memcpy(buf + 1, data, len);
    i2c_master_transmit(oled_handle, buf, len + 1, -1);
}

// OLED initialization and utility functions
static void oled_init(void) {
    uint8_t cmds[] = {
        0xAE, 0x20, 0x00, 0x21, 0x00, 0x7F, 0x22, 0x00, 0x07, 
        0x81, 0x7F, 0xA1, 0xC8, 0xA6, 0xA8, 0x3F, 0xD3, 0x00, 
        0xD5, 0x80, 0xD9, 0x22, 0xDA, 0x12, 0xDB, 0x20, 
        0x8D, 0x14, 0xAF
    };
    for (int i = 0; i < sizeof(cmds); i++) {
        oled_cmd(cmds[i]);
    }
}

static void oled_fill(uint8_t pattern) {
    uint8_t page_data[128];
    memset(page_data, pattern, sizeof(page_data));
    for (int i = 0; i < 8; i++) {
        oled_cmd(0xB0 + i);
        oled_cmd(0x00);
        oled_cmd(0x10);
        oled_data(page_data, 128);
    }
}

static void oled_print(uint8_t page, uint8_t col, const char *str) {
    oled_cmd(0xB0 + page);                    // Row/page          
    oled_cmd(0x00 + (col & 0x0F));            // Column
    oled_cmd(0x10 + ((col >> 4) & 0x0F));     // Text

    while (*str) {
        if (*str >= 32 && *str <= 90) {
            oled_data(font5x8[*str - 32], 5);
        }
        uint8_t space = 0x00;
        oled_data(&space, 1);
        str++;
    }
}

static void oled_clear(void) {
    uint8_t page_data[128];
    memset(page_data, 0x00, sizeof(page_data));
    
    uint8_t buf[129];
    buf[0] = 0x40; 
    memcpy(buf + 1, page_data, 128);

    for (int i = 0; i < 8; i++) {
        oled_cmd(0xB0 + i); 
        oled_cmd(0x00);     
        oled_cmd(0x10);    
        i2c_master_transmit(oled_handle, buf, 129, -1);
    }
}
